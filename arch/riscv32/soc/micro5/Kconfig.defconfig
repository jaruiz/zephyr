## arch/riscv32/soc/micro5/Kconfig.defconfig
```kconfig
if SOC_RISCV32_MICRO5

config SOC
	string
	default "micro5"

config SYS_CLOCK_HW_CYCLES_PER_SEC
	int
	default 4000000

config RISCV_SOC_CONTEXT_SAVE
	bool
	default n

config RISCV_SOC_INTERRUPT_INIT
	bool
	default y

config RISCV_HAS_CPU_IDLE
	bool
	default y

config INCLUDE_RESET_VECTOR
	bool
	default y

config NUM_IRQS
	int
	default 8

config MICRO5_ROM_BASE_ADDRESS
	hex
	default	0x00000000

config MICRO5_ROM_SIZE
	hex
	default 0x8000

config MICRO5_RAM_BASE_ADDRESS
	hex
	default 0x00010000

config MICRO5_RAM_SIZE
	hex
	default 0x4000


if MICRO5_TIMER

config MICRO5_TIMER_BASE
	hex
	default 0x10000100

config MICRO5_TIMER_IRQ
	int
	default 0


endif # MICRO5_TIMER


if UART_MICRO5

config UART_MICRO5_BASE
	hex
	default 0x10000000

config UART_MICRO5_PORT_0_NAME
	string
	default "uart0"

config UART_MICRO5_PORT_0_BAUD_RATE
	int
	default 115200

endif # UART_MICRO5


endif # SOC_RISCV32_MICRO5
```

## arch/riscv32/soc/micro5/Kconfig.soc
```kconfig
config SOC_RISCV32_MICRO5
	bool "SoC implementation around micro5 RISC-V"
	select ATOMIC_OPERATIONS_C
	select CONFIG_RISCV_GENERIC_TOOLCHAIN
```

## boards/riscv32/ice40up5k_micro5/Kconfig.board
```kconfig
config BOARD_ICE40UP5K_MICRO5
	bool "iCE40UP5K-B-EVN micro5 RISC-V target"
	depends on SOC_RISCV32_MICRO5
```

## boards/riscv32/ice40up5k_micro5/Kconfig.defconfig
```kconfig
if BOARD_ICE40UP5K_MICRO5

config BOARD
	default "ice40up5k_micro5"

config GPIO_MICRO5
	def_bool y


endif
```

## boards/riscv32/ice40up5k_micro5/ice40up5k_micro5_defconfig
```kconfig
CONFIG_RISCV32=y
CONFIG_SOC_RISCV32_MICRO5=y
CONFIG_BOARD_ICE40UP5K_MICRO5=y
CONFIG_CONSOLE=y
CONFIG_PRINTK=y
CONFIG_SERIAL=y
CONFIG_UART_MICRO5=y
CONFIG_UART_CONSOLE=y
CONFIG_UART_CONSOLE_ON_DEV_NAME="uart0"
CONFIG_MICRO5_TIMER=y
CONFIG_GPIO=y
CONFIG_GPIO_MICRO5=y
CONFIG_BOOT_BANNER=y
```

## drivers/gpio/Kconfig.micro5
```kconfig
# Kconfig.micro5 - Config options for Micro5 GPIO
#
# SPDX-License-Identifier: Apache-2.0

menuconfig GPIO_MICRO5
	bool "Micro5 GPIO driver"
	depends on GPIO && CONFIG_SOC_RISCV32_MICRO5
	help
	  Enable support for the Micro5 GPIO controllers.
```

## drivers/serial/Kconfig.micro5
```kconfig
menuconfig UART_MICRO5
	bool "Driver for Micro5 mini-UART"
	select SERIAL_HAS_DRIVER
	select SERIAL_SUPPORT_INTERRUPT
	help
	  This option enables the Micro5-UART serial driver.

# ---------- Port 0 ----------

menuconfig UART_MICRO5_PORT_0
	bool "Enable Micro5-UART Port 0 (the only port by default)"
	depends on UART_MICRO5
	help
	  This tells the driver to configure the UART port at boot, depending on
	  the additional configure options below.

config UART_MICRO5_PORT_0_NAME
	string "Port 0 Device Name"
	default "uart0"
	depends on UART_MICRO5_PORT_0
	help
	  This is the device name for UART, and is included in the device
	  struct.

config UART_MICRO5_PORT_0_BAUD_RATE
	int "Port 0 Baud Rate"
	default 0
	depends on UART_MICRO5_PORT_0
	help
	  The baud rate for UART port to be set to at boot.

	  Leave at 0 to skip initialization.
```
